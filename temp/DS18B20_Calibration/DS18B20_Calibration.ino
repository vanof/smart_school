/******************************************/
#include <OneWire.h>     // подключаем библиотеку для управления устройствами по Протоколу 1-Wire, в нашем случае термодатчиками DS18B20 
OneWire DS18B20(2);      // с помощью конст-ра библиотеки опр-ем условное название объекта OneWire и номер выв. к которому он подключен
                         // в данном случае объект OneWire называется так же как называется и сам датчик 
#define POWER_MODE 0     // Определяем режим питания датчиков, 0 - внешнее, 1 – паразитное (#define задает имя и значение константе)
#define POWER_DS18B20 6  // Определяем вывод 6 платы для подачи питания на датчик и светодиод 
 
#define TIME_OUT 750            // задаем время (мс) между командами 44h ("измерить температуру") и BEh ("читать температуру")
byte conf[3]={0x00,0x00,0x7F};  // третий элемент массива это байт для записи в регистр конфигурации для установки разрешения
                                // разрешение преобразования температуры может устанавливаться:
                                // 1F (9 бит;0.5°C;93.75мс), 3F (10 бит;0.25°C;187.5мс)
                                // 5F (11 бит;0.125°C;375мс),7F (12 бит;0,0625°C;750мс) 
uint16_t i;
uint32_t ms1, ms2;              // переменные для хранения промежуточных значений пройденного времени
boolean go, count;              // логическая переменная 
float temperature;              // переменная типа float для хранения значения измеренной температуры
byte data[9];                   // массив для размещения девяти байт после чтения памяти датчика 18B20
                       
void setup() {  
  Serial.begin(9600);                //инициализируем работу с монитором порта в Arduino IDE (инструменты/монитор порта)
  pinMode (POWER_DS18B20, OUTPUT);     
  digitalWrite(POWER_DS18B20, HIGH);   // подаем питание на датчик через вывод POWER_DS18B20 для изменения регистра конфигурации
  DS18B20.reset();                     // инициализация датчика для работы с оперативной памятью
  DS18B20.write(0xCC, POWER_MODE);     // 0xCC - команда пропуск ROM 
  DS18B20.write(0x4E, POWER_MODE);     // 0x4E - команда на запись байта конфигурации в оперативную память
  DS18B20.write_bytes(conf, 3);        // передаем данные из массива conf в оперативную память датчика
  DS18B20.reset();                     // инициализация датчика для работы с энергонезависимой памятью
  DS18B20.write(0xCC, POWER_MODE);     // 0xCC - команда пропуск ROM 
  DS18B20.write(0x48, POWER_MODE);     // 0x48 - команда записи байта конфигурации из операт. памяти в энергонез.память
  digitalWrite(POWER_DS18B20, LOW);    // отключаем питание датчика        
}
void loop() {   
  if (Serial.read() == 'r') {          // символ "r" является командой на вкл. датчика и начало процесса измер-я темп-ры
    go = true;                         // устанавливаем флаг начала процесса измерения температуры
    digitalWrite(POWER_DS18B20, HIGH); // подаем питание на датчик
    ms2 = millis();                    // фиксируем начало периода вывода значений температуры в монитор порта
  }
  if (go == true) {    
    if (count==0) {
      DS18B20.reset();                    // инициализация датчика для измерения температуры
      DS18B20.write(0xCC, POWER_MODE);    // 0xCC - команда пропуск ROM 
      DS18B20.write(0x44, POWER_MODE);    // 0х44 - команда на выполнение преобразования температуры 
      count=!count;                       // установим флаг, что выполняется процесс преобразования температуры 
      ms1 = millis();                     // фиксируем начало периода обращения к датчику
    } 
    if ((millis() - ms1) > TIME_OUT) {    // условие, выполняющееся если прошел период времени, превышающий TIME_OUT (мс)   
      DS18B20.reset();                    // инициализация датчика для чтения памяти
      DS18B20.write(0xCC, POWER_MODE);    // команда пропуск ROM,  
      DS18B20.write(0xBE, POWER_MODE);    // 0хBE - команда чтения памяти
      DS18B20.read_bytes(data, 9);        // читаем девять байт из памяти датчика побайтно и сохраняем в массив data
      int16_t raw = (data[1]<<8)|data[0]; // обработка байтов регистра измер-ой темп-ры (операция сдвига, операция ИЛИ)
      temperature = (float)raw / 16;      // преобразуем полученные данные в значение температуры в градусах Цельсия
      count=!count;                       // сбросим флаг процесса преобразования температуры 
    }
    if (( millis() - ms2) > 1000) {       // условие выполняется каждую секунду и выводит знач. темп. в монитор порта, 
      ms2 = millis(); 
      Serial.print(temperature,4);        // выводим температуру, после запятой оставляем 4 знака
      Serial.print(" ");
      Serial.println(i++);                // выводим счетчик секунд
    }
  }
}
